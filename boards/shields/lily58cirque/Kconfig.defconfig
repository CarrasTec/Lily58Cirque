## boards/shields/lily58cirque/Kconfig.defconfig
```kconfig
if SHIELD_LILY58CIRQUE_RIGHT

# Name must be less than 16 characters long!
config ZMK_KEYBOARD_NAME
    default "Lily58Cirque"

config ZMK_SPLIT_ROLE_CENTRAL
    default y



endif

if SHIELD_LILY58CIRQUE_RIGHT || SHIELD_LILY58CIRQUE_LEFT

config ZMK_SPLIT
    default y

config I2C
	default y

config ZMK_POINTING
    default y

endif
```
